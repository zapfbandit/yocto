## meta-adt/conf/layer.conf
```bitbake
# We have a conf and classes directory, add to BBPATH
BBPATH .= ":${LAYERDIR}"

# We have recipes-* directories, add to BBFILES
BBFILES += "${LAYERDIR}/recipes-*/*/*.bb \
            ${LAYERDIR}/recipes-*/*/*.bbappend"

BBFILE_COLLECTIONS += "meta-adt"
BBFILE_PATTERN_meta-adt = "^${LAYERDIR}/"
BBFILE_PRIORITY_meta-adt = "7"

LAYERDEPENDS_meta-adt = "core"
LAYERSERIES_COMPAT_meta-adt = "dunfell"
```
